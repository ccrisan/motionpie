## boot/Config.in
```kconfig
menu "Bootloaders"

source "boot/grub/Config.in"
source "boot/grub2/Config.in"
source "boot/syslinux/Config.in"
source "boot/uboot/Config.in"
source "boot/rpi-firmware/Config.in"

endmenu
```

## boot/rpi-firmware/Config.in
```kconfig
config BR2_TARGET_RPI_FIRMWARE
	bool "rpi-firmware"
	depends on BR2_arm
	help
	  RaspberryPi Firmware

	  https://github.com/raspberrypi/firmware
```

## boot/rpi/Config.in
```kconfig
config BR2_TARGET_RPI
	bool "rpi"
	depends on BR2_arm
	help
	  RaspberryPi Boot Formware

	  https://github.com/raspberrypi/firmware
```

## configs/raspberrypi-3.10_defconfig
```kconfig
BR2_arm=y
BR2_arm1176jzf_s=y

#
# uClibc Options
#
BR2_UCLIBC_CONFIG="board/raspberrypi/uClibc-0.9.33.config"

#
# Kernel Header Options
#
BR2_KERNEL_HEADERS_VERSION=y
BR2_DEFAULT_KERNEL_HEADERS="3.10.38"
BR2_DEFAULT_KERNEL_VERSION="3.10.38"
BR2_PACKAGE_HOST_LINUX_HEADERS_CUSTOM_3_10=y

#
# GCC Options
#
BR2_EXTRA_GCC_CONFIG_OPTIONS="--with-float=hard"
# BR2_SOFT_FLOAT is not set
BR2_TARGET_OPTIMIZATION="-pipe -mhard-float"

#
# Toolchain Options
#
BR2_TOOLCHAIN_BUILDROOT_CXX=y
BR2_TOOLCHAIN_BUILDROOT_LARGEFILE=y

#
# System configuration
#
BR2_ROOTFS_DEVICE_CREATION_DYNAMIC_DEVTMPFS=y
BR2_ROOTFS_SKELETON_CUSTOM=y
BR2_ROOTFS_SKELETON_CUSTOM_PATH="board/raspberrypi/skeleton"
BR2_ROOTFS_POST_BUILD_SCRIPT="board/raspberrypi/postscript.sh"
BR2_TARGET_GENERIC_GETTY_PORT="ttyAMA0"
BR2_TARGET_GENERIC_HOSTNAME="rpi"
BR2_TARGET_GENERIC_ISSUE=""

#
# Package Selection for the target
#
BR2_PACKAGE_RPI_USERLAND=y

#
# Filesystem images
#
BR2_TARGET_ROOTFS_TAR=y
BR2_TARGET_ROOTFS_TAR_NONE=y

#
# Bootloaders
#
BR2_TARGET_RPI_FIRMWARE=y

#
# Kernel
#
BR2_LINUX_KERNEL=y
BR2_LINUX_KERNEL_CUSTOM_VERSION=y
BR2_LINUX_KERNEL_CUSTOM_VERSION_VALUE="3.10.38"
BR2_LINUX_KERNEL_VERSION="3.10.38"
BR2_LINUX_KERNEL_PATCH="http://dl.guillermoamaral.com/rpi/kernel-3.10.38.patch"
BR2_LINUX_KERNEL_USE_DEFCONFIG=y
BR2_LINUX_KERNEL_DEFCONFIG="bcmrpi_quick"
BR2_LINUX_KERNEL_ZIMAGE=y
```

## configs/raspberrypi-3.9_defconfig
```kconfig
BR2_arm=y
BR2_arm1176jzf_s=y

#
# Build options
#
BR2_OPTIMIZE_3=y

#
# Toolchain
#
BR2_TOOLCHAIN_BUILDROOT=y

#
# Kernel Header Options
#
BR2_KERNEL_HEADERS_VERSION=y
BR2_DEFAULT_KERNEL_VERSION="3.9.5"
BR2_DEFAULT_KERNEL_HEADERS="3.9.5"

#
# uClibc Options
#
BR2_UCLIBC_CONFIG="board/raspberrypi/uClibc.config"

#
# GCC Options
#
BR2_EXTRA_GCC_CONFIG_OPTIONS="--with-float=hard"
# BR2_SOFT_FLOAT is not set
BR2_TARGET_OPTIMIZATION="-pipe -mhard-float"

#
# Toolchain Options
#
BR2_TOOLCHAIN_BUILDROOT_CXX=y
BR2_TOOLCHAIN_BUILDROOT_INET_RPC=y
BR2_TOOLCHAIN_BUILDROOT_LARGEFILE=y
BR2_TOOLCHAIN_BUILDROOT_LOCALE=y
BR2_TOOLCHAIN_BUILDROOT_WCHAR=y
BR2_VFP_FLOAT=y

#
# System configuration
#
BR2_TARGET_GENERIC_HOSTNAME="rpi"
BR2_TARGET_GENERIC_ISSUE=""
BR2_ROOTFS_DEVICE_CREATION_DYNAMIC_DEVTMPFS=y
BR2_ROOTFS_SKELETON_CUSTOM=y
BR2_ROOTFS_SKELETON_CUSTOM_PATH="board/raspberrypi/skeleton"
BR2_ROOTFS_POST_BUILD_SCRIPT="board/raspberrypi/postscript.sh"

#
# Package Selection for the target
#
BR2_PACKAGE_BUSYBOX_CONFIG="board/raspberrypi/busybox.config"

BR2_PACKAGE_ALSA_UTILS=y

BR2_PACKAGE_ALSA_UTILS_ALSACTL=y
BR2_PACKAGE_ALSA_UTILS_ALSAMIXER=y
BR2_PACKAGE_ALSA_LIB=y

BR2_PACKAGE_ZLIB=y

BR2_PACKAGE_OPENSSL=y

BR2_PACKAGE_NCURSES=y
BR2_PACKAGE_NCURSES_TARGET_PANEL=y
BR2_PACKAGE_NCURSES_TARGET_FORM=y
BR2_PACKAGE_NCURSES_TARGET_MENU=y

BR2_PACKAGE_NTP=y
BR2_PACKAGE_NTP_NTPD=y
BR2_PACKAGE_NTP_NTPDATE=y

BR2_PACKAGE_OPENSSH=y

BR2_PACKAGE_RPI_USERLAND=y

#
# Filesystem images
#
BR2_TARGET_ROOTFS_TAR=y
BR2_TARGET_ROOTFS_TAR_NONE=y

#
# Bootloaders
#
BR2_TARGET_RPI=y

#
# Kernel
#
BR2_LINUX_KERNEL=y
BR2_LINUX_KERNEL_CUSTOM_VERSION=y
BR2_LINUX_KERNEL_CUSTOM_VERSION_VALUE="3.9.5"
BR2_LINUX_KERNEL_VERSION="3.9.5"
BR2_LINUX_KERNEL_PATCH="http://dl.guillermoamaral.com/rpi/kernel-3.9.5.patch"
BR2_LINUX_KERNEL_USE_DEFCONFIG=y
BR2_LINUX_KERNEL_DEFCONFIG="bcmrpi"
BR2_LINUX_KERNEL_ZIMAGE=y
```

## defconfig
```kconfig
BR2_arm=y
BR2_arm1176jzf_s=y
BR2_ARM_EABIHF=y
BR2_DL_DIR="$(TOPDIR)/../.buildroot-dl"
BR2_CCACHE=y
BR2_CCACHE_DIR="$(TOPDIR)/../.buildroot-ccache"
BR2_OPTIMIZE_2=y
BR2_KERNEL_HEADERS_VERSION=y
BR2_DEFAULT_KERNEL_VERSION="3.12.30"
BR2_PACKAGE_HOST_LINUX_HEADERS_CUSTOM_3_12=y
BR2_UCLIBC_CONFIG="board/raspberrypi/uClibc-0.9.33.config"
BR2_TOOLCHAIN_BUILDROOT_LARGEFILE=y
BR2_TOOLCHAIN_BUILDROOT_INET_IPV6=y
BR2_TOOLCHAIN_BUILDROOT_WCHAR=y
BR2_BINUTILS_VERSION_2_24=y
BR2_EXTRA_GCC_CONFIG_OPTIONS="--with-float=hard"
BR2_TOOLCHAIN_BUILDROOT_CXX=y
BR2_TARGET_OPTIMIZATION="-pipe -mhard-float"
BR2_TARGET_GENERIC_HOSTNAME="motionpie"
BR2_TARGET_GENERIC_ISSUE=""
BR2_ROOTFS_DEVICE_CREATION_DYNAMIC_EUDEV=y
BR2_ROOTFS_SKELETON_CUSTOM=y
BR2_ROOTFS_SKELETON_CUSTOM_PATH="board/raspberrypi/skeleton"
BR2_ROOTFS_OVERLAY="board/raspberrypi/skeleton"
BR2_ROOTFS_POST_BUILD_SCRIPT="board/raspberrypi/postscript.sh"
BR2_LINUX_KERNEL=y
BR2_LINUX_KERNEL_CUSTOM_VERSION=y
BR2_LINUX_KERNEL_CUSTOM_VERSION_VALUE="3.12.30"
BR2_LINUX_KERNEL_PATCH="board/raspberrypi/linux-rpi-3.12.30.patch"
BR2_LINUX_KERNEL_USE_CUSTOM_CONFIG=y
BR2_LINUX_KERNEL_CUSTOM_CONFIG_FILE="board/raspberrypi/kernel.config"
BR2_LINUX_KERNEL_ZIMAGE=y
BR2_PACKAGE_BUSYBOX_CONFIG="board/raspberrypi/busybox-1.22.x.config"
BR2_PACKAGE_BUSYBOX_SHOW_OTHERS=y
BR2_PACKAGE_MOTIONEYE=y
BR2_PACKAGE_FFMPEG=y
BR2_PACKAGE_FFMPEG_GPL=y
BR2_PACKAGE_FFMPEG_NONFREE=y
BR2_PACKAGE_MOTION=y
BR2_PACKAGE_GZIP=y
BR2_PACKAGE_GETTEXT=y
BR2_PACKAGE_TAR=y
BR2_PACKAGE_CIFS_UTILS=y
BR2_PACKAGE_E2FSPROGS=y
# BR2_PACKAGE_E2FSPROGS_BADBLOCKS is not set
# BR2_PACKAGE_E2FSPROGS_CHATTR is not set
BR2_PACKAGE_E2FSPROGS_DEBUGFS=y
# BR2_PACKAGE_E2FSPROGS_DUMPE2FS is not set
# BR2_PACKAGE_E2FSPROGS_E2FREEFRAG is not set
# BR2_PACKAGE_E2FSPROGS_E2LABEL is not set
# BR2_PACKAGE_E2FSPROGS_E2UNDO is not set
# BR2_PACKAGE_E2FSPROGS_FILEFRAG is not set
# BR2_PACKAGE_E2FSPROGS_FINDFS is not set
# BR2_PACKAGE_E2FSPROGS_LOGSAVE is not set
# BR2_PACKAGE_E2FSPROGS_LSATTR is not set
# BR2_PACKAGE_E2FSPROGS_MKLOSTFOUND is not set
# BR2_PACKAGE_E2FSPROGS_TUNE2FS is not set
# BR2_PACKAGE_E2FSPROGS_UUIDGEN is not set
BR2_PACKAGE_NTFS_3G=y
BR2_PACKAGE_B43_FIRMWARE=y
BR2_PACKAGE_LINUX_FIRMWARE=y
BR2_PACKAGE_LINUX_FIRMWARE_ATHEROS_7010=y
BR2_PACKAGE_LINUX_FIRMWARE_ATHEROS_9170=y
BR2_PACKAGE_LINUX_FIRMWARE_ATHEROS_9271=y
BR2_PACKAGE_LINUX_FIRMWARE_RALINK_RT61=y
BR2_PACKAGE_LINUX_FIRMWARE_RALINK_RT73=y
BR2_PACKAGE_LINUX_FIRMWARE_RALINK_RT2XX=y
BR2_PACKAGE_LINUX_FIRMWARE_RTL_81XX=y
BR2_PACKAGE_LINUX_FIRMWARE_RTL_87XX=y
BR2_PACKAGE_LINUX_FIRMWARE_TI_WL127X=y
BR2_PACKAGE_LINUX_FIRMWARE_TI_WL128X=y
BR2_PACKAGE_PYTHON=y
BR2_PACKAGE_PYTHON_SSL=y
BR2_PACKAGE_PYTHON_ZLIB=y
BR2_PACKAGE_PYTHON_HASHLIB=y
BR2_PACKAGE_PYTHON_JINJA2=y
BR2_PACKAGE_PYTHON_JSON_SCHEMA_VALIDATOR=y
BR2_PACKAGE_PYTHON_MARKUPSAFE=y
BR2_PACKAGE_PYTHON_PILLOW=y
BR2_PACKAGE_PYTHON_PYTZ=y
BR2_PACKAGE_PYTHON_TORNADO=y
BR2_PACKAGE_LIBFUSE=y
BR2_PACKAGE_LIBV4L=y
BR2_PACKAGE_LIBV4L_UTILS=y
BR2_PACKAGE_LIBXML2=y
BR2_PACKAGE_LIBCURL=y
BR2_PACKAGE_CURL=y
BR2_PACKAGE_LIBICONV=y
BR2_PACKAGE_CRDA=y
BR2_PACKAGE_DHCP=y
BR2_PACKAGE_DHCP_CLIENT=y
BR2_PACKAGE_NET_TOOLS=y
BR2_PACKAGE_NTP=y
BR2_PACKAGE_NTP_NTPDATE=y
BR2_PACKAGE_OPENSSH=y
BR2_PACKAGE_PPPD=y
BR2_PACKAGE_SAMBA=y
BR2_PACKAGE_SAMBA_MAX_DEBUGLEVEL=10
# BR2_PACKAGE_SAMBA_EVENTLOGADM is not set
# BR2_PACKAGE_SAMBA_NET is not set
# BR2_PACKAGE_SAMBA_NMBLOOKUP is not set
# BR2_PACKAGE_SAMBA_NTLM_AUTH is not set
# BR2_PACKAGE_SAMBA_PDBEDIT is not set
# BR2_PACKAGE_SAMBA_PROFILES is not set
# BR2_PACKAGE_SAMBA_RPCCLIENT is not set
# BR2_PACKAGE_SAMBA_SMBCACLS is not set
# BR2_PACKAGE_SAMBA_SMBCONTROL is not set
# BR2_PACKAGE_SAMBA_SMBCQUOTAS is not set
# BR2_PACKAGE_SAMBA_SMBGET is not set
# BR2_PACKAGE_SAMBA_SMBLDBTOOLS is not set
# BR2_PACKAGE_SAMBA_SMBPASSWD is not set
# BR2_PACKAGE_SAMBA_SMBSHARESEC is not set
# BR2_PACKAGE_SAMBA_SMBSPOOL is not set
# BR2_PACKAGE_SAMBA_SMBSTATUS is not set
# BR2_PACKAGE_SAMBA_SMBTREE is not set
# BR2_PACKAGE_SAMBA_SWAT is not set
# BR2_PACKAGE_SAMBA_SMBTA_UTIL is not set
# BR2_PACKAGE_SAMBA_SMBTAR is not set
# BR2_PACKAGE_SAMBA_TDB is not set
# BR2_PACKAGE_SAMBA_TESTPARM is not set
# BR2_PACKAGE_SAMBA_WINBINDD is not set
BR2_PACKAGE_SAMBA_LIBSMBCLIENT=y
BR2_PACKAGE_WGET=y
BR2_PACKAGE_WIRELESS_TOOLS=y
BR2_PACKAGE_WPA_SUPPLICANT=y
BR2_PACKAGE_WPA_SUPPLICANT_CLI=y
BR2_PACKAGE_BASH=y
BR2_PACKAGE_UTIL_LINUX_BINARIES=y
BR2_PACKAGE_UTIL_LINUX_PARTX=y
BR2_PACKAGE_NANO=y
BR2_PACKAGE_RPI_USERLAND=y
BR2_TARGET_RPI_FIRMWARE=y
BR2_TARGET_RPI_FIRMWARE_X=y
```

## package/gevent/Config.in
```kconfig
config BR2_PACKAGE_GEVENT
	bool "gevent"
	depends on BR2_PACKAGE_PYTHON
	depends on BR2_PACKAGE_GREENLET
	depends on BR2_PACKAGE_LIBEVENT

	help
	  gevent is a Python networking library that uses greenlet to 
	  provide synchronous API on top of libevent event loop.
	  
	  http://www.gevent.org/
```

## package/greenlet/Config.in
```kconfig
config BR2_PACKAGE_GREENLET
	bool "greenlet"
	depends on BR2_PACKAGE_PYTHON
	help
	
	  The greenlet package is a spin-off of Stackless, 
	  a version of CPython that supports micro-threads 
	  called "tasklets". Tasklets run pseudo-concurrently 
	  (typically in a single or a few OS-level threads) 
	  and are synchronized with data exchanges on "channels".

	  https://pypi.python.org/pypi/greenlet
```

## package/python-imaging/Config.in
```kconfig
config BR2_PACKAGE_PYTHON_IMAGING
        bool "python-imaging"
        depends on BR2_PACKAGE_PYTHON
        select BR2_PACKAGE_DISTRIBUTE
        select BR2_PACKAGE_ZLIB
        select BR2_PACKAGE_FREETYPE
        select BR2_PACKAGE_JPEG_LIBRARY
        help
          The Python Imaging Library (PIL) adds image processing capabilities to your
          Python interpreter. This library supports many file formats, and provides
          powerful image processing and graphics capabilities.

          http://www.pythonware.com/products/pil/
```

## package/python-jinja2/Config.in
```kconfig
config BR2_PACKAGE_PYTHON_JINJA2
	bool "python-jinja2"
	depends on BR2_PACKAGE_PYTHON
```

## package/python-markupsafe/Config.in
```kconfig
config BR2_PACKAGE_PYTHON_MARKUPSAFE
	bool "python-markupsafe"
	depends on BR2_PACKAGE_PYTHON
```

## package/python-setuptools/Config.in.host
```kconfig
config BR2_PACKAGE_HOST_PYTHON_SETUPTOOLS
	bool "host python-setuptools"
	help
	  Download, build, install, upgrade, and uninstall Python packages.
	
	  http://pypi.python.org/pypi/setuptools
```

## package/python-wiringpi2/Config.in
```kconfig
config BR2_PACKAGE_PYTHON_WIRINGPI2
	bool "python-wiringpi2"
	depends on BR2_PACKAGE_PYTHON
	depends on BR2_PACKAGE_HOST_PYTHON_SETUPTOOLS
	
	help
	  wiringPi C libraries and python bindings
```

## package/raspberrypi/Config.in
```kconfig
menu "Raspberry Pi"
	depends on BR2_arm
	menu "Libraries"
		source package/raspberrypi/rpi-userland/Config.in
		source package/raspberrypi/wiringpi/Config.in
	endmenu
endmenu
```

## package/raspberrypi/rpi-userland/Config.in
```kconfig
config BR2_PACKAGE_RPI_USERLAND
	depends on BR2_arm
	depends on BR2_INSTALL_LIBSTDCPP
	depends on BR2_LARGEFILE
        bool "rpi-userland"
        help
          Raspberry Pi Userland

          https://github.com/raspberrypi/userland/
```

## package/swig/Config.in
```kconfig
config BR2_PACKAGE_SWIG
	bool "swig"
	depends on BR2_INSTALL_LIBSTDCPP
	help
	  SWIG is a software development tool that connects programs written
	  in C and C++ with a variety of high-level programming languages.

	  http://www.swig.org/

comment "swig requires C++ support in toolchain"
	depends on !BR2_INSTALL_LIBSTDCPP
```

## package/wiringpi/Config.in
```kconfig
config BR2_PACKAGE_WIRINGPI
	bool "wiringpi"
	depends on BR2_arm
	help
	  GPIO Interface library for the Raspberry Pi.

	  http://wiringpi.com/
```
